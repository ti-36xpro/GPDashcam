#include <stdio.h>
#include <string.h>
#include "freertos/FreeRTOS.h"
#include "freertos/task.h"
#include "esp_log.h"
#include "driver/i2c_master.h"
#include "esp_lcd_panel_io.h"
#include "esp_lcd_panel_vendor.h"
#include "esp_lcd_panel_ops.h"
#include "esp_err.h"
#include "esp_log.h"

#include <stdio.h>
#include <unistd.h>

#define TAG "lcd_simple"

// I2C pins
#define I2C_BUS_PORT 0
#define SDA_PIN 41
#define SCL_PIN 42
#define I2C_ADDR 0x3C

// LCD resolution
#define LCD_H 128
#define LCD_V 64

// LCD pixel clock
#define LCD_PIXEL_CLOCK_HZ (400 * 1000)

// Display buffer (1-bit monochrome)
static uint8_t oled_buffer[LCD_H * LCD_V / 8];

// Forward declarations
float read_accel_x(void);
float read_accel_y(void);
float read_accel_z(void);
void read_gps(char *buf);

// clears buffer
static void oled_clear(void) {
    memset(oled_buffer, 0x00, sizeof(oled_buffer));
}

void draw_char(uint8_t x, uint8_t y, char c);
void draw_string(uint8_t x, uint8_t y, const char *str);

// Task to update sensor display
void sensor_display_task(void *arg) {
    esp_lcd_panel_handle_t panel = (esp_lcd_panel_handle_t)arg;
    char buf[128];

    while (1) {
        float ax = read_accel_x();
        float ay = read_accel_y();
        float az = read_accel_z();
        char gps_buf[64];
        read_gps(gps_buf);

        // Text to send to screen
        snprintf(buf, sizeof(buf), "GPDashcam\n\nAccelerometer:\n%.2f %.2f %.2f\n%s", ax, ay, az, gps_buf);
        //snprintf(buf, sizeof(buf), "abcdefghijklm\nnopqrstuvwxyz");

        oled_clear();

        // Draw string into buffer at (0,0)
        draw_string(0, 0, buf);

        // Send buffer to SSD1306
        esp_lcd_panel_draw_bitmap(panel, 0, 0, LCD_H, LCD_V, oled_buffer);

        vTaskDelay(pdMS_TO_TICKS(1000)); // 1 second
    }
}

void app_main(void)
{
    ESP_LOGI(TAG, "Initialize I2C bus");
    i2c_master_bus_handle_t i2c_bus;
    i2c_master_bus_config_t bus_config = {
        .clk_source = I2C_CLK_SRC_DEFAULT,
        .glitch_ignore_cnt = 7,
        .i2c_port = I2C_BUS_PORT,
        .sda_io_num = SDA_PIN,
        .scl_io_num = SCL_PIN,
        .flags.enable_internal_pullup = true,
    };
    ESP_ERROR_CHECK(i2c_new_master_bus(&bus_config, &i2c_bus));

    ESP_LOGI(TAG, "Install SSD1306 panel driver");
    esp_lcd_panel_io_i2c_config_t io_config = {
        .dev_addr = I2C_ADDR,
        .scl_speed_hz = LCD_PIXEL_CLOCK_HZ,
        .control_phase_bytes = 1,
        .lcd_cmd_bits = 8,
        .lcd_param_bits = 8,
        .dc_bit_offset = 6,
    };

    esp_lcd_panel_io_handle_t io_handle;
    ESP_ERROR_CHECK(esp_lcd_new_panel_io_i2c(i2c_bus, &io_config, &io_handle));

    esp_lcd_panel_handle_t panel_handle;
    esp_lcd_panel_dev_config_t panel_config = {
        .bits_per_pixel = 1,
        .reset_gpio_num = -1,
    };
    esp_lcd_panel_ssd1306_config_t ssd1306_config = {
        .height = LCD_V,
    };
    panel_config.vendor_config = &ssd1306_config;
    ESP_ERROR_CHECK(esp_lcd_new_panel_ssd1306(io_handle, &panel_config, &panel_handle));
    ESP_ERROR_CHECK(esp_lcd_panel_reset(panel_handle));
    ESP_ERROR_CHECK(esp_lcd_panel_init(panel_handle));
    ESP_ERROR_CHECK(esp_lcd_panel_disp_on_off(panel_handle, true));

    // Start periodic sensor display task
    xTaskCreate(sensor_display_task, "sensor_display", 4096, panel_handle, 2, NULL);
}

// Dummy sensor functions
float read_accel_x(void) { return 1.23; }
float read_accel_y(void) { return 4.56; }
float read_accel_z(void) { return 7.89; }
void read_gps(char *buf) { snprintf(buf, 64, "GPS:\n12.3456,-78.9012"); }

// 5x7 font table (ASCII 0x20–0x7F)
static const uint8_t font5x7[96][5] = {
    {0x00,0x00,0x00,0x00,0x00}, // ' '
    {0x00,0x00,0x5F,0x00,0x00}, // '!'
    {0x00,0x07,0x00,0x07,0x00}, // '"'
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    {0x02,0x01,0x02,0x04,0x02}, // '~'
};


void draw_char(uint8_t x, uint8_t y, char c) {
    if (c < 32 || c > 127) return;
    const uint8_t *ch = font5x7[c - 32];
    for (int i = 0; i < 5; i++) {
        uint8_t col = ch[i];
        for (int j = 0; j < 7; j++) {
            if (col & (1 << j)) {
                int byte_index = ((y + j) / 8) * LCD_H + (x + i);
                oled_buffer[byte_index] |= 1 << ((y + j) % 8);
            }
        }
    }
}

void draw_string(uint8_t x, uint8_t y, const char *str) {
    uint8_t cursor_x = x;
    uint8_t cursor_y = y;
    while (*str) {
        if (*str == '\n') {
            cursor_x = x;
            cursor_y += 8;
        } else {
            draw_char(cursor_x, cursor_y, *str);
            cursor_x += 6;
        }
        str++;
    }
}