## firmware/components/esp_lcd/Kconfig
```kconfig
menu "ESP-Driver:LCD Controller Configurations"
    config LCD_ENABLE_DEBUG_LOG
        bool "Enable debug log"
        default n
        help
            whether to enable the debug log message for LCD driver.
            Note that, this option only controls the LCD driver log, won't affect other drivers.
endmenu
```

## firmware/main/Kconfig.projbuild
```kconfig
menu "GPDashcam Configuration"

    config RX_PIN_NUM
        int "RX pin number"
        default 42
        help
            GPIO number for UART RX pin

    config SDA_PIN_NUM
        int "SDA pin number"
        default 1
        help
			GPIO number for i2c SDA pin

    config SCL_PIN_NUM
        int "SCL pin number"
        default 2
        help
			GPIO number for i2c SCL pin

    choice SDMMC_BUS_WIDTH
        prompt "SD/MMC bus width"
        default EXAMPLE_SDMMC_BUS_WIDTH_4

        config EXAMPLE_SDMMC_BUS_WIDTH_4
            bool "4 lines (D0 - D3)"

        config EXAMPLE_SDMMC_BUS_WIDTH_1
            bool "1 line (D0)"
    endchoice

    choice SDMMC_SPEED_MODE
        prompt "SD/MMC speed mode"
        default EXAMPLE_SDMMC_SPEED_DS

        config EXAMPLE_SDMMC_SPEED_DS
            bool "Default Speed"
        config EXAMPLE_SDMMC_SPEED_HS
            bool "High Speed"
        config EXAMPLE_SDMMC_SPEED_UHS_I_SDR50
            bool "UHS-I SDR50 (100 MHz, 50 MB/s)"
            depends on SOC_SDMMC_UHS_I_SUPPORTED
        config EXAMPLE_SDMMC_SPEED_UHS_I_DDR50
            bool "UHS-I DDR50 (50 MHz, 50 MB/s)"
            depends on SOC_SDMMC_UHS_I_SUPPORTED
    endchoice

    config CMD_PIN_NUM
        int
        prompt "CMD pin number" 
        default 38

    config CLK_PIN_NUM
        int
        prompt "CLK pin number"
        default 39

    config D0_PIN_NUM
        int
        prompt "D0 pin number"
        default 47

    if EXAMPLE_SDMMC_BUS_WIDTH_4

        config EXAMPLE_PIN_D1
            int
            prompt "D1 GPIO number"
            default 21 

        config EXAMPLE_PIN_D2
            int
            prompt "D2 GPIO number"
            default 41


        config EXAMPLE_PIN_D3
            int
            prompt "D3 GPIO number"
            default 40

    endif  # EXAMPLE_SDMMC_BUS_WIDTH_4
endmenu
```
